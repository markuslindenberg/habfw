## Config.in
```kconfig
source "$BR2_EXTERNAL_HABFW_PATH/package/zulu/Config.in"
source "$BR2_EXTERNAL_HABFW_PATH/package/openhab/Config.in"
source "$BR2_EXTERNAL_HABFW_PATH/package/openhab-addons/Config.in"
source "$BR2_EXTERNAL_HABFW_PATH/package/deconz/Config.in"
source "$BR2_EXTERNAL_HABFW_PATH/package/zram-tools/Config.in"
source "$BR2_EXTERNAL_HABFW_PATH/package/node_exporter/Config.in"
```

## configs/habfw_raspberrypi4_defconfig
```kconfig
BR2_arm=y
BR2_cortex_a72=y
BR2_ARM_FPU_NEON_VFPV4=y
BR2_STRIP_EXCLUDE_DIRS="opt"
# BR2_PIC_PIE is not set
BR2_SSP_NONE=y
BR2_RELRO_NONE=y
BR2_FORTIFY_SOURCE_NONE=y
BR2_TOOLCHAIN_BUILDROOT_GLIBC=y
BR2_PACKAGE_HOST_LINUX_HEADERS_CUSTOM_5_10=y
BR2_TOOLCHAIN_BUILDROOT_CXX=y
BR2_TARGET_GENERIC_HOSTNAME="openhab"
BR2_TARGET_GENERIC_ISSUE="github.com/markuslindenberg/habfw"
BR2_INIT_SYSTEMD=y
BR2_SYSTEM_BIN_SH_BASH=y
BR2_TARGET_GENERIC_GETTY_PORT="tty1"
# BR2_TARGET_GENERIC_REMOUNT_ROOTFS_RW is not set
BR2_GENERATE_LOCALE="en_US"
BR2_ROOTFS_OVERLAY="$(BR2_EXTERNAL_HABFW_PATH)/board/common/rootfs-overlay"
BR2_ROOTFS_POST_BUILD_SCRIPT="$(BR2_EXTERNAL_HABFW_PATH)/board/common/post-build.sh"
BR2_ROOTFS_POST_IMAGE_SCRIPT="$(BR2_EXTERNAL_HABFW_PATH)/board/raspberrypi4/post-image.sh"
BR2_LINUX_KERNEL=y
BR2_LINUX_KERNEL_CUSTOM_TARBALL=y
BR2_LINUX_KERNEL_CUSTOM_TARBALL_LOCATION="$(call github,raspberrypi,linux,stable_20211118)/linux-stable_20211118.tar.gz"
BR2_LINUX_KERNEL_DEFCONFIG="bcm2711"
BR2_LINUX_KERNEL_CONFIG_FRAGMENT_FILES="$(BR2_EXTERNAL_HABFW_PATH)/board/raspberrypi4/kernel.config"
BR2_LINUX_KERNEL_ZSTD=y
BR2_LINUX_KERNEL_DTS_SUPPORT=y
BR2_LINUX_KERNEL_INTREE_DTS_NAME="bcm2711-rpi-4-b"
BR2_LINUX_KERNEL_NEEDS_HOST_OPENSSL=y
BR2_PACKAGE_LINUX_TOOLS_GPIO=y
BR2_PACKAGE_BUSYBOX_CONFIG="$(BR2_EXTERNAL_HABFW_PATH)/board/common/busybox.config"
BR2_PACKAGE_DOSFSTOOLS=y
BR2_PACKAGE_DOSFSTOOLS_FSCK_FAT=y
BR2_PACKAGE_DOSFSTOOLS_MKFS_FAT=y
BR2_PACKAGE_F2FS_TOOLS=y
BR2_PACKAGE_SQUASHFS_ZSTD=y
BR2_PACKAGE_RPI_FIRMWARE=y
BR2_PACKAGE_RPI_FIRMWARE_VARIANT_PI4=y
BR2_PACKAGE_RPI_WIFI_FIRMWARE=y
BR2_PACKAGE_RNG_TOOLS=y
# BR2_PACKAGE_RNG_TOOLS_JITTERENTROPY_LIBRARY is not set
BR2_PACKAGE_CA_CERTIFICATES=y
BR2_PACKAGE_CRYPTODEV=y
BR2_PACKAGE_LIBCURL_CURL=y
# BR2_PACKAGE_LIBCURL_EXTRA_PROTOCOLS_FEATURES is not set
BR2_PACKAGE_LIBSECCOMP=y
BR2_PACKAGE_IWD=y
BR2_PACKAGE_MOSQUITTO=y
BR2_PACKAGE_MTR=y
BR2_PACKAGE_OPENSSH=y
BR2_PACKAGE_RSYNC=y
BR2_PACKAGE_TCPDUMP=y
BR2_PACKAGE_WIRELESS_REGDB=y
BR2_PACKAGE_BASH_COMPLETION=y
BR2_PACKAGE_PROCPS_NG=y
BR2_PACKAGE_RAUC=y
BR2_PACKAGE_RAUC_NETWORK=y
BR2_PACKAGE_RAUC_JSON=y
BR2_PACKAGE_SYSTEMD_JOURNAL_REMOTE=y
# BR2_PACKAGE_SYSTEMD_PSTORE is not set
# BR2_PACKAGE_SYSTEMD_HOSTNAMED is not set
BR2_PACKAGE_SYSTEMD_REPART=y
# BR2_PACKAGE_SYSTEMD_VCONSOLE is not set
BR2_TARGET_ROOTFS_SQUASHFS=y
BR2_TARGET_ROOTFS_SQUASHFS4_ZSTD=y
# BR2_TARGET_ROOTFS_TAR is not set
BR2_PACKAGE_HOST_DOSFSTOOLS=y
BR2_PACKAGE_HOST_GENIMAGE=y
BR2_PACKAGE_HOST_MTOOLS=y
BR2_PACKAGE_HOST_RAUC=y
BR2_PACKAGE_ZULU=y
BR2_PACKAGE_OPENHAB=y
BR2_PACKAGE_OPENHAB_ADDONS=y
BR2_PACKAGE_ZRAM_TOOLS=y
BR2_PACKAGE_NODE_EXPORTER=y
```

## package/deconz/Config.in
```kconfig
config BR2_PACKAGE_DECONZ
	bool "deconz"
	depends on BR2_INSTALL_LIBSTDCPP
	depends on BR2_TOOLCHAIN_HAS_THREADS
	depends on !BR2_STATIC_LIBS
	depends on BR2_PACKAGE_SYSTEMD
	depends on BR2_PACKAGE_HAS_UDEV
	select BR2_PACKAGE_ZLIB
	select BR2_PACKAGE_PCRE2
	select BR2_PACKAGE_EXPAT
	select BR2_PACKAGE_LIBCAP
	select BR2_PACKAGE_MESA3D
	select BR2_PACKAGE_MESA3D_GALLIUM_DRIVER_SWRAST
	select BR2_PACKAGE_MESA3D_OPENGL_GLX
	select BR2_PACKAGE_MESA3D_OPENGL_ES
	select BR2_PACKAGE_XORG7
	select BR2_PACKAGE_SQLITE
	select BR2_PACKAGE_SQLITE_ENABLE_COLUMN_METADATA
	select BR2_PACKAGE_QT5
	select BR2_PACKAGE_QT5BASE_GUI
	select BR2_PACKAGE_QT5BASE_WIDGETS
	select BR2_PACKAGE_QT5BASE_SQL
	select BR2_PACKAGE_QT5SERIALPORT
	select BR2_PACKAGE_QT5WEBSOCKETS
	select BR2_PACKAGE_QT5BASE_SQLITE_SYSTEM
	help
	  The Phoscon App to integrate and control many popular Zigbee
	  devices and to setup automations and rules.

	  https://www.phoscon.de/en/conbee2/software
```

## package/openhab-addons/Config.in
```kconfig
config BR2_PACKAGE_OPENHAB_ADDONS
	bool "openhab-addons"
	depends on BR2_PACKAGE_OPENHAB
	help
	  a vendor and technology agnostic open source automation
	  software for your home

	  https://www.openhab.org/
```

## package/openhab/Config.in
```kconfig
config BR2_PACKAGE_OPENHAB
	bool "openhab"
	select BR2_PACKAGE_ZIP
	select BR2_PACKAGE_UNZIP
	help
	  a vendor and technology agnostic open source automation
	  software for your home

	  https://www.openhab.org/
```

## package/restic/Config.in
```kconfig
config BR2_PACKAGE_RESTIC
	bool "restic"
	depends on BR2_PACKAGE_HOST_GO_TARGET_ARCH_SUPPORTS
	help
	  Fast, secure, efficient backup program

	  https://github.com/restic/restic
```

## package/zram-tools/Config.in
```kconfig
config BR2_PACKAGE_ZRAM_TOOLS
	bool "zram-tools"
	select BR2_PACKAGE_UTIL_LINUX_ZRAMCTL
	select BR2_PACKAGE_UTIL_LINUX_BINARIES
	help
	  utilities for working with zram

	  https://packages.debian.org/bullseye/zram-tools
```

## package/zulu/Config.in
```kconfig
config BR2_PACKAGE_ZULU
	bool "zulu"
	help
	  Zulu Build of OpenJDK

	  https://www.azul.com/products/zulu-embedded/
```
